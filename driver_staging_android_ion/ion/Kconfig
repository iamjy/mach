## driver_staging_android_ion/ion/Kconfig
```kconfig
menuconfig ION
	bool "ION Memory Manager"
	depends on HAVE_MEMBLOCK
	select GENERIC_ALLOCATOR
	select DMA_SHARED_BUFFER
	---help---
	  Chose this option to enable the ION Memory Manager,
	  used by Android to efficiently allocate buffers
	  from userspace that can be shared between drivers.
	  If you're not using Android its probably safe to
	  say N here.

config ION_TEST
	tristate "ION Test Device"
	depends on ION && !ION_TEGRA && !ION_MV_VICTORIA
	help
	  Choose this option to create a device that can be used to test the
	  kernel and device side ION functions.

config ION_DUMMY
	bool "Dummy ION driver"
	depends on ION && ION_TEST
	help
	  Provides a dummy ION driver that registers the
	  /dev/ion device and some basic heaps. This can
	  be used for testing the ION infrastructure if
	  one doesn't have access to hardware drivers that
	  use ION.

config ION_TEGRA
	tristate "ION for Tegra"
	depends on ARCH_TEGRA && ION
	help
	  Choose this option if you wish to use ION on an nVidia Tegra.

config ION_MV_VICTORIA
	tristate "ION for VICTORIA"
	depends on ARCH_MV89XX && ION
	help
	  Choose this option if you wish to use ION on an Mtevision Victoria SOC FPGA.

config ION_MV_MFP7V2000TQ
	tristate "ION for mfp7v2000tq"
	depends on ARCH_MVT12SOCFPGA && ION
	help
	  Choose this option if you wish to use ION on an Mtevision MFP-7V2000T-Q SOC FPGA.
```

## mach-mv89xx/Kconfig
```kconfig
if ARCH_MV89XX

config PLAT_MV89XX
	def_bool y
	help
	  Base platform code for any Mtekvision MV89XX devices

menu "MV89XX SoCs Supports"

comment "MV89XX SoCs"

config CPU_MV8930
	bool "MV8930"
	default y

if CPU_MV8930

comment "MV8930 Board Type"

config FPGA_TYPE
	bool "FPGA"
	default y

config VICTORIA_FPGA_BOARD
	depends on FPGA_TYPE
	bool "VICTORIA FPGA Board (ARM9 based)"
	select CPU_ARM926T
	select SOC_BUS
	select CLKSRC_VICTORIA_FPGA_PWM
	select GENERIC_CLOCKEVENTS
	select VICTORIA_FPGA_IRQ
	default y
	help
	  This FPGA is for ODIN-CSS H/W block verification

choice
	depends on VICTORIA_FPGA_BOARD
	prompt "Select Memory Type"
	default VICTORIA_LPDDR2_128MB

config VICTORIA_LPDDR2_128MB
	bool "LPDDR2 128MB"

endchoice # Select Memory Type"

choice
	depends on VICTORIA_FPGA_BOARD
	prompt "Select Debug UART"

config VICTORIA_DEBUG_UART0
	bool "UART0"

config VICTORIA_DEBUG_UART1
	bool "UART1"

config VICTORIA_DEBUG_UART2
	bool "UART2"

config VICTORIA_DEBUG_UART3
	bool "UART3"

endchoice # Select Debug UART

config EVB_TYPE
	bool "EVB"

config POP_TYPE
	bool "POP"

endif # CPU_MV8930

endmenu # MTEKVISION MV89XX SoCs Supports

menu "MV89XX Platform Common Options"

comment "Boot Options"

comment "Power Management"

endmenu # Platform Common Options"

endif # ARCH_MV89XX
```

## mach-mvt12socfpga/Kconfig
```kconfig
if  ARCH_MVT12SOCFPGA

config PLAT_MVT12SOCFPGA
	def_bool y
	help
	  Base platform code for T12 SoC FPGA based on ARM9EJ-S

menu "MVT12 SoCs Supports"

comment "MVT12 SoCs"

config CPU_MVT12SOCFPGA
	bool "T12FPGA"
	select FPGA_TYPE
	default y

if CPU_MVT12SOCFPGA

comment "MVT12 Board Type"

config FPGA_TYPE
	bool "FPGA"
	select MFP_7V2000T_Q_FPGA_BOARD

if FPGA_TYPE

config MFP_7V2000T_Q_FPGA_BOARD
	bool "MFP-7V2000T-Q FPGA B'd (ARM9 based)"
	select CPU_ARM926T
	select SOC_BUS
	select CLKSRC_MVMFP_7V2000T_Q_FPGA_PWM
	select GENERIC_CLOCKEVENTS
	select MVMFP_7V2000T_Q_FPGA_IRQ

choice
	depends on FPGA_TYPE
	prompt "Select Memory Type"
	default T12_DDR3_512MB

config T12_DDR3_4GB
	bool "DDR3 4GB"

config T12_DDR3_512MB
	bool "DDR3 512MB"

endchoice # Select Memory Type

choice
	depends on FPGA_TYPE
	prompt "Select Debug UART"

config MFP_7V2000T_Q_DEBUG_UART0
	bool "UART0"

config MFP_7V2000T_Q_DEBUG_UART1
	bool "UART1"

config MFP_7V2000T_Q_DEBUG_UART2
	bool "UART2"

endchoice # Select Debug UART

endif # FPGA_TYPE

config EVB_TYPE
	bool "EVB"

config POP_TYPE
	bool "POP"

endif # CPU_MVT12SOCFPGA

endmenu # MTEKVISION MVT12 SoCs Supports

menu "MVt12 Platform Common Options"

comment "Boot Options"

comment "Power Management"

endmenu # Platform Common Options"

endif # ARCH_MVT12SOCFPGA
```
